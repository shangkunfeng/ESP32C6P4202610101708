## sdkconfig.defaults
```kconfig
# ESP32-P4 (JC1060P470C 类模组默认，与 TouchPanel 工程对齐)
CONFIG_IDF_TARGET="esp32p4"
CONFIG_ESPTOOLPY_FLASHMODE_QIO=y
CONFIG_ESPTOOLPY_FLASHSIZE_16MB=y
CONFIG_PARTITION_TABLE_CUSTOM=y
CONFIG_PARTITION_TABLE_CUSTOM_FILENAME="partitions.csv"
CONFIG_COMPILER_OPTIMIZATION_PERF=y
CONFIG_SPIRAM=y
CONFIG_SPIRAM_SPEED_200M=y
CONFIG_SPIRAM_XIP_FROM_PSRAM=y
CONFIG_CACHE_L2_CACHE_256KB=y
CONFIG_CACHE_L2_CACHE_LINE_128B=y
CONFIG_ESP_MAIN_TASK_STACK_SIZE=10240
CONFIG_FREERTOS_HZ=1000
CONFIG_IDF_EXPERIMENTAL_FEATURES=y
CONFIG_ESP32P4_SELECTS_REV_LESS_V3=y
CONFIG_ESP32P4_REV_MIN_100=y
# 日志从 USB Serial/JTAG（COM5）输出
CONFIG_ESP_CONSOLE_USB_SERIAL_JTAG=y
# LVGL 9（Kconfig，无自定义 lv_conf.h）
CONFIG_LV_CONF_SKIP=y
CONFIG_LV_COLOR_DEPTH_16=y
CONFIG_LV_COLOR_DEPTH=16
CONFIG_LV_DEF_REFR_PERIOD=33
CONFIG_LV_OS_FREERTOS=y
CONFIG_FREERTOS_GENERATE_RUN_TIME_STATS=y
CONFIG_FREERTOS_RUN_TIME_STATS_USING_ESP_TIMER=y
# 10 屏 + 图表/字体：64KB 内置池易在首帧绘制时耗尽 → Store access fault
CONFIG_LV_USE_BUILTIN_MALLOC=n
CONFIG_LV_USE_CLIB_MALLOC=y
CONFIG_LV_USE_CLIB_STRING=y
CONFIG_LV_FONT_MONTSERRAT_28=y
CONFIG_LV_FONT_SOURCE_HAN_SANS_SC_16_CJK=y
# SD 卡：须支持长文件名（ESP32P4C6Photo、background0.bin 等，默认 LFN_NONE 会 open failed）
CONFIG_FATFS_LFN_NONE=n
CONFIG_FATFS_LFN_HEAP=y
CONFIG_FATFS_MAX_LFN=255
CONFIG_FATFS_SECTOR_512=y
CONFIG_FATFS_SECTOR_4096=n
# C6 协处理器 Wi-Fi（ESP-Hosted + esp_wifi_remote）
CONFIG_SLAVE_IDF_TARGET_ESP32C6=y
CONFIG_SPIRAM_TRY_ALLOCATE_WIFI_LWIP=y
CONFIG_ESP_HOSTED=y
CONFIG_ESP_HOSTED_AUTO_CALL_INIT_BEFORE_APP_MAIN=y
CONFIG_ESP_HOSTED_CP_TARGET_ESP32C6=y
CONFIG_ESP_HOSTED_HOST_TRANSPORT_BUS_SDIO=y
```
